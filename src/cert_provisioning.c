/*
 * Certificate Provisioning for AWS IoT
 * Loads certificates into modem secure storage
 */

#include "cert_provisioning.h"
#include <zephyr/kernel.h>
#include <modem/modem_key_mgmt.h>
#include <zephyr/logging/log.h>
#include <string.h>

/* Certificate headers (generated by convert_certs.py) */
#include "certs/aws_root_ca.h"
#include "certs/device_cert.h"
#include "certs/device_key.h"

LOG_MODULE_REGISTER(cert_prov, LOG_LEVEL_INF);

bool cert_provisioning_check(void)
{
	bool exists;
	int err;

	/* Check root CA */
	err = modem_key_mgmt_exists(AWS_SEC_TAG_ROOT_CA,
	                            MODEM_KEY_MGMT_CRED_TYPE_CA_CHAIN,
	                            &exists);
	if (err || !exists) {
		return false;
	}

	/* Check device certificate */
	err = modem_key_mgmt_exists(AWS_SEC_TAG_DEVICE_CERT,
	                            MODEM_KEY_MGMT_CRED_TYPE_PUBLIC_CERT,
	                            &exists);
	if (err || !exists) {
		return false;
	}

	/* Check private key */
	err = modem_key_mgmt_exists(AWS_SEC_TAG_DEVICE_KEY,
	                            MODEM_KEY_MGMT_CRED_TYPE_PRIVATE_CERT,
	                            &exists);
	if (err || !exists) {
		return false;
	}

	return true;
}

int cert_provisioning_init(void)
{
	int err;

	LOG_INF("Provisioning AWS certificates to modem...");

	/* Root CA */
	err = modem_key_mgmt_write(AWS_SEC_TAG_ROOT_CA,
	                           MODEM_KEY_MGMT_CRED_TYPE_CA_CHAIN,
	                           aws_root_ca_pem,
	                           strlen(aws_root_ca_pem));
	if (err) {
		LOG_ERR("Failed to provision root CA: %d", err);
		return err;
	}
	LOG_DBG("Root CA provisioned");

	/* Device certificate */
	err = modem_key_mgmt_write(AWS_SEC_TAG_DEVICE_CERT,
	                           MODEM_KEY_MGMT_CRED_TYPE_PUBLIC_CERT,
	                           device_cert_pem,
	                           strlen(device_cert_pem));
	if (err) {
		LOG_ERR("Failed to provision device cert: %d", err);
		return err;
	}
	LOG_DBG("Device certificate provisioned");

	/* Private key */
	err = modem_key_mgmt_write(AWS_SEC_TAG_DEVICE_KEY,
	                           MODEM_KEY_MGMT_CRED_TYPE_PRIVATE_CERT,
	                           device_private_key_pem,
	                           strlen(device_private_key_pem));
	if (err) {
		LOG_ERR("Failed to provision private key: %d", err);
		return err;
	}
	LOG_DBG("Private key provisioned");

	LOG_INF("All certificates provisioned successfully");
	return 0;
}
