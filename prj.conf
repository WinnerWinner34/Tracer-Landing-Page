## CMakeLists.txt
```
# FleetTracker - CMakeLists.txt for SDK v3.1.1
# Based on cellular/location sample

cmake_minimum_required(VERSION 3.20.0)

find_package(Zephyr REQUIRED HINTS $ENV{ZEPHYR_BASE})
project(FleetTracker)

# Include src directory for cert headers
target_include_directories(app PRIVATE src)

# Application source files
target_sources(app PRIVATE
    src/main.c
    src/transmission_manager.c
    src/device_identity.c
    src/cert_provisioning.c
    src/mqtt_manager.c
    src/aws_protocol.c
)
```

## prj.conf
```kconfig
#
# Fleet Tracker - Phase 2A Configuration (FIXED)
# nRF Connect SDK v3.1.1
# 
# Configuration Strategy:
# - A-GNSS enabled for fast fixes when LTE available
# - CONFIG_LOCATION_SERVICE_EXTERNAL=y allows standalone GPS without LTE
# - RTT configuration optimized for 3Hz GPS output
# - WATCHDOG DISABLED for debugging
#

# General config
CONFIG_FPU=y
CONFIG_NRF_MODEM_LIB=y

# Heap and stacks
CONFIG_MAIN_STACK_SIZE=4096
CONFIG_HEAP_MEM_POOL_SIZE=8192
CONFIG_SYSTEM_WORKQUEUE_STACK_SIZE=1536
CONFIG_AT_MONITOR_HEAP_SIZE=1024

# Location library
CONFIG_LOCATION=y

# CRITICAL: Enables standalone GPS operation without cloud dependency
# GPS works with or without LTE/A-GNSS assistance
CONFIG_LOCATION_SERVICE_EXTERNAL=y

# RTT Configuration - CRITICAL SETTINGS (DO NOT CHANGE)
# These settings prevent RTT hang and ensure stable output at 3Hz GPS
CONFIG_USE_SEGGER_RTT=y
CONFIG_SEGGER_RTT_BUFFER_SIZE_UP=4096
CONFIG_RTT_CONSOLE=y
CONFIG_UART_CONSOLE=n
CONFIG_LOG=y
CONFIG_LOG_BACKEND_RTT=y
CONFIG_LOG_BUFFER_SIZE=1024
CONFIG_LOG_BACKEND_RTT_OUTPUT_BUFFER_SIZE=256
CONFIG_LOG_MODE_DEFERRED=y
CONFIG_LOG_BACKEND_RTT_MODE_DROP=y
CONFIG_LOG_BACKEND_RTT_RETRY_CNT=1
CONFIG_LOG_BACKEND_RTT_RETRY_DELAY_MS=1
CONFIG_LOG_PRINTK=y

# Network
CONFIG_NETWORKING=y
CONFIG_NET_NATIVE=n
CONFIG_NET_SOCKETS=y
CONFIG_NET_SOCKETS_OFFLOAD=y

# LTE link control
CONFIG_LTE_LINK_CONTROL=y
CONFIG_LTE_LC_EDRX_MODULE=y
CONFIG_LTE_EDRX_REQ=y
CONFIG_LTE_LC_PSM_MODULE=y
CONFIG_LTE_PSM_REQ_RAT="00000100"

# AT Host library
CONFIG_UART_INTERRUPT_DRIVEN=y
CONFIG_AT_HOST_LIBRARY=y

# A-GNSS Support (optional - GPS works without it)
# These configs enable A-GNSS assistance when LTE is connected
# If LTE is not available, GPS operates standalone (slower first fix)
CONFIG_NRF_CLOUD=y
CONFIG_NRF_CLOUD_REST=y
CONFIG_NRF_CLOUD_AGNSS=y
CONFIG_MODEM_INFO=y
CONFIG_MODEM_INFO_ADD_NETWORK=y

# Certificate Management - Required for AWS device certificates
CONFIG_MODEM_KEY_MGMT=y

# ============================================================================
# AWS IoT Core - MQTT + TLS Configuration
# ============================================================================

# MQTT Client Library
CONFIG_MQTT_LIB=y
CONFIG_MQTT_LIB_TLS=y

# TLS/mbedTLS - Required for secure MQTT connection to AWS
CONFIG_MBEDTLS=y
CONFIG_MBEDTLS_TLS_VERSION_1_2=y

# nRF Security with Nordic Security Backend
CONFIG_NRF_SECURITY=y
CONFIG_NORDIC_SECURITY_BACKEND=y
CONFIG_MBEDTLS_TLS_LIBRARY=y

# TF-M Crypto Dependencies
CONFIG_MBEDTLS_ECP_C=y
CONFIG_MBEDTLS_ECDH_C=y
CONFIG_MBEDTLS_ECDSA_C=y
CONFIG_MBEDTLS_PK_C=y
CONFIG_MBEDTLS_PK_WRITE_C=y
CONFIG_MBEDTLS_SSL_CONTEXT_SERIALIZATION=n

# TLS Credentials
CONFIG_TLS_CREDENTIALS=y

# Date/time and JWT (required for A-GNSS)
CONFIG_DATE_TIME=y
CONFIG_MODEM_JWT=y

# CRITICAL: DISABLE WATCHDOG FOR DEBUGGING
# This prevents the 3-minute restart issue while we debug
# Re-enable once system is stable
CONFIG_WATCHDOG=n
CONFIG_TASK_WDT=n

# Thread monitoring for debugging
CONFIG_THREAD_MONITOR=y
CONFIG_THREAD_NAME=y
CONFIG_THREAD_STACK_INFO=y

# Debug settings
CONFIG_DEBUG=y
CONFIG_ASSERT=y
CONFIG_ASSERT_LEVEL=2

# Modem fault handling - CRITICAL for debugging
CONFIG_NRF_MODEM_LIB_ON_FAULT_APPLICATION_SPECIFIC=y

# Prevent immediate reset on fatal error to see diagnostics
CONFIG_RESET_ON_FATAL_ERROR=n

# APN Configuration - replaces manual AT+CGDCONT
#CONFIG_LTE_NETWORK_DEFAULT_APN="uscc00000.enterprise0.usc-cdp"
```

## src/aws_protocol.c
```c
/*
 * AWS Protocol - Binary Message Encoding
 * Implements binary GPS format per documentation.md
 * SDK 3.1.1 - No checksum validation (zeros sent)
 */

#include "aws_protocol.h"
#include <zephyr/kernel.h>
#include <zephyr/logging/log.h>
#include <string.h>

LOG_MODULE_REGISTER(aws_protocol, LOG_LEVEL_INF);

/* Encode single full GPS position */
static void encode_full_gps(const struct location_event_data *loc,
                            struct full_gps *out)
{
    /* Convert double to int32 (degrees * 10^7) */
    out->latitude = (int32_t)(loc->location.latitude * 10000000.0);
    out->longitude = (int32_t)(loc->location.longitude * 10000000.0);

    // TODO: These fields not available in SDK 3.1.1 location_data
    /* Altitude in meters */
    // out->altitude = (int16_t)loc->location.altitude;
    out->altitude = 0;

    /* Speed: km/h * 10 */
    // out->speed = (uint16_t)(loc->location.speed * 3.6 * 10.0);  /* m/s to km/h */
    out->speed = 0;

    /* Heading: degrees * 10 */
    // out->heading = (uint16_t)(loc->location.heading * 10.0);
    out->heading = 0;
    
    /* Accuracy in meters (capped at 255) */
    out->accuracy = (uint8_t)(loc->location.accuracy > 255 ? 255 : loc->location.accuracy);
    
    /* Satellites and HDOP - not available in location API, use defaults */
    out->sats = 0;      /* TODO: Get from GNSS subsystem if needed */
    out->hdop = 0;      /* TODO: Get from GNSS subsystem if needed */
}

/* Encode compressed GPS position */
static void encode_compressed_gps(const struct location_event_data *loc,
                                  uint16_t time_offset,
                                  struct compressed_gps *out)
{
    /* Convert double to int32 (degrees * 10^7) */
    out->latitude = (int32_t)(loc->location.latitude * 10000000.0);
    out->longitude = (int32_t)(loc->location.longitude * 10000000.0);

    // TODO: These fields not available in SDK 3.1.1 location_data
    /* Speed: km/h * 10 */
    // out->speed = (uint16_t)(loc->location.speed * 3.6 * 10.0);
    out->speed = 0;
    
    /* Time offset from first fix */
    out->time_offset = time_offset;
}

/* Encode GPS batch into binary format */
int aws_encode_gps_batch(const struct location_event_data *locations,
                         uint8_t count,
                         uint8_t *output_buffer,
                         size_t *output_len)
{
    if (!locations || !output_buffer || !output_len || count == 0 || count > 20) {
        LOG_ERR("Invalid parameters");
        return -EINVAL;
    }

    LOG_INF("📦 Encoding GPS batch: %d locations", count);

    uint8_t *ptr = output_buffer;
    
    /* Reserve space for header (will fill at end) */
    struct tel_header *header = (struct tel_header *)ptr;
    ptr += sizeof(struct tel_header);
    
    /* Message body starts here */
    uint8_t *body_start = ptr;
    
    /* Tel Enumerator: 0x01 for GPS batch */
    *ptr++ = TEL_ENUMERATOR_GPS_BATCH;
    
    /* Timestamp: 64-bit UNIX timestamp */
    uint64_t timestamp = (uint64_t)(k_uptime_get() / 1000);  /* Convert ms to seconds */
    memcpy(ptr, &timestamp, sizeof(timestamp));
    ptr += sizeof(timestamp);
    
    /* First GPS position (Full GPS - 20 bytes) */
    struct full_gps first_gps;
    encode_full_gps(&locations[0], &first_gps);
    memcpy(ptr, &first_gps, sizeof(first_gps));
    ptr += sizeof(first_gps);
    
    /* Count of compressed GPS (0 if only 1 position) */
    uint8_t compressed_count = count - 1;
    *ptr++ = compressed_count;
    
    /* Compressed GPS array (if more than 1 position) */
    for (uint8_t i = 1; i < count; i++) {
        struct compressed_gps comp;
        
        /* Time offset: assume 1 second between fixes (1Hz GPS) */
        uint16_t time_offset = i;
        
        encode_compressed_gps(&locations[i], time_offset, &comp);
        memcpy(ptr, &comp, sizeof(comp));
        ptr += sizeof(comp);
    }
    
    /* Calculate message body size */
    size_t body_size = ptr - body_start;
    
    /* Fill header */
    header->size = (uint16_t)body_size;  /* Little-endian */
    /* No checksum - AWS backend doesn't validate */
    memset(header->checksum, 0, 28);
    
    /* Total message size */
    *output_len = sizeof(struct tel_header) + body_size;
    
    LOG_INF("✅ Encoded: %zu bytes (header: %zu, body: %zu)",
            *output_len, sizeof(struct tel_header), body_size);
    LOG_INF("   Full GPS: 1, Compressed GPS: %d", compressed_count);
    
    return 0;
}
```

## src/aws_protocol.h
```c
/*
 * AWS Protocol - Binary Message Encoding
 * Implements custom binary format from documentation.md
 */

#ifndef AWS_PROTOCOL_H
#define AWS_PROTOCOL_H

#include <stdint.h>
#include <modem/location.h>

/* Binary Message Structures (Little-Endian) */

/* Tel Header: size + unused checksum (zeros) */
struct tel_header {
    uint16_t size;           /* Message size excluding header */
    uint8_t checksum[28];    /* Unused - filled with zeros */
} __attribute__((packed));

/* Full GPS (20 bytes) */
struct full_gps {
    int32_t latitude;        /* Degrees * 10^7 */
    int32_t longitude;       /* Degrees * 10^7 */
    int16_t altitude;        /* Meters */
    uint16_t speed;          /* km/h * 10 */
    uint16_t heading;        /* Degrees * 10 */
    uint8_t accuracy;        /* Meters */
    uint8_t sats;            /* Satellite count */
    uint16_t hdop;           /* HDOP * 10 */
} __attribute__((packed));

/* Compressed GPS (12 bytes) */
struct compressed_gps {
    int32_t latitude;        /* Degrees * 10^7 */
    int32_t longitude;       /* Degrees * 10^7 */
    uint16_t speed;          /* km/h * 10 */
    uint16_t time_offset;    /* Seconds from first timestamp */
} __attribute__((packed));

/* Message Type 0x01: Full GPS + Compressed GPS Series */
#define TEL_ENUMERATOR_GPS_BATCH 0x01

/**
 * Encode GPS batch into binary format
 * 
 * @param locations Array of GPS fixes
 * @param count Number of fixes (1-20)
 * @param output_buffer Output buffer for binary message
 * @param output_len Returns message length
 * @return 0 on success, negative on error
 */
int aws_encode_gps_batch(const struct location_event_data *locations,
                         uint8_t count,
                         uint8_t *output_buffer,
                         size_t *output_len);

#endif /* AWS_PROTOCOL_H */
```

## src/cert_provisioning.c
```c
/*
 * Certificate Provisioning for AWS IoT
 * Loads certificates into modem secure storage
 */

#include "cert_provisioning.h"
#include <zephyr/kernel.h>
#include <modem/modem_key_mgmt.h>
#include <zephyr/logging/log.h>
#include <string.h>

/* Certificate headers (generated by convert_certs.py) */
#include "certs/aws_root_ca.h"
#include "certs/device_cert.h"
#include "certs/device_key.h"

LOG_MODULE_REGISTER(cert_prov, LOG_LEVEL_INF);

bool cert_provisioning_check(void)
{
	bool exists;
	int err;

	/* Check root CA */
	err = modem_key_mgmt_exists(AWS_SEC_TAG_ROOT_CA,
	                            MODEM_KEY_MGMT_CRED_TYPE_CA_CHAIN,
	                            &exists);
	if (err || !exists) {
		return false;
	}

	/* Check device certificate */
	err = modem_key_mgmt_exists(AWS_SEC_TAG_DEVICE_CERT,
	                            MODEM_KEY_MGMT_CRED_TYPE_PUBLIC_CERT,
	                            &exists);
	if (err || !exists) {
		return false;
	}

	/* Check private key */
	err = modem_key_mgmt_exists(AWS_SEC_TAG_DEVICE_KEY,
	                            MODEM_KEY_MGMT_CRED_TYPE_PRIVATE_CERT,
	                            &exists);
	if (err || !exists) {
		return false;
	}

	return true;
}

int cert_provisioning_init(void)
{
	int err;

	LOG_INF("Provisioning AWS certificates to modem...");

	/* Root CA */
	err = modem_key_mgmt_write(AWS_SEC_TAG_ROOT_CA,
	                           MODEM_KEY_MGMT_CRED_TYPE_CA_CHAIN,
	                           aws_root_ca_pem,
	                           strlen(aws_root_ca_pem));
	if (err) {
		LOG_ERR("Failed to provision root CA: %d", err);
		return err;
	}
	LOG_DBG("Root CA provisioned");

	/* Device certificate */
	err = modem_key_mgmt_write(AWS_SEC_TAG_DEVICE_CERT,
	                           MODEM_KEY_MGMT_CRED_TYPE_PUBLIC_CERT,
	                           device_cert_pem,
	                           strlen(device_cert_pem));
	if (err) {
		LOG_ERR("Failed to provision device cert: %d", err);
		return err;
	}
	LOG_DBG("Device certificate provisioned");

	/* Private key */
	err = modem_key_mgmt_write(AWS_SEC_TAG_DEVICE_KEY,
	                           MODEM_KEY_MGMT_CRED_TYPE_PRIVATE_CERT,
	                           device_private_key_pem,
	                           strlen(device_private_key_pem));
	if (err) {
		LOG_ERR("Failed to provision private key: %d", err);
		return err;
	}
	LOG_DBG("Private key provisioned");

	LOG_INF("All certificates provisioned successfully");
	return 0;
}
```

## src/cert_provisioning.h
```c
/*
 * Certificate Provisioning for AWS IoT
 */

#ifndef CERT_PROVISIONING_H
#define CERT_PROVISIONING_H

#include <stdbool.h>

/* Security tag definitions for AWS IoT certificates */
#define AWS_SEC_TAG_ROOT_CA    16842753
#define AWS_SEC_TAG_DEVICE_CERT 16842754
#define AWS_SEC_TAG_DEVICE_KEY  16842755

/**
 * Check if AWS certificates are already provisioned in modem storage
 * Returns: true if all certificates exist, false otherwise
 */
bool cert_provisioning_check(void);

/**
 * Provision AWS certificates to modem secure storage
 * Only writes if certificates are missing (check-first, write-once)
 * Returns: 0 on success, negative errno on failure
 */
int cert_provisioning_init(void);

#endif /* CERT_PROVISIONING_H */
```

## src/device_identity.c
```c
/*
 * Device Identity - IMEI Extraction and Device ID Generation
 */

#include "device_identity.h"
#include <zephyr/kernel.h>
#include <modem/modem_info.h>
#include <string.h>

static char device_imei[32];
static char device_id[32];
static bool initialized = false;

int device_identity_init(void)
{
	int err;

	printk("🔧 Initializing device identity...\n");

	/* Extract IMEI from modem */
	err = modem_info_init();
	if (err) {
		printk("❌ Failed to init modem_info: %d\n", err);
		return err;
	}

	err = modem_info_string_get(MODEM_INFO_IMEI, device_imei, sizeof(device_imei));
	if (err < 0) {
		printk("❌ Failed to get IMEI: %d\n", err);
		return err;
	}

	printk("📱 IMEI: %s\n", device_imei);

	/* Generate device ID from last 8 digits of IMEI */
	size_t imei_len = strlen(device_imei);
	if (imei_len >= 8) {
		snprintf(device_id, sizeof(device_id), "FLT-DEV-%s",
		         device_imei + imei_len - 8);
	} else {
		snprintf(device_id, sizeof(device_id), "FLT-DEV-UNKNOWN");
	}

	printk("✅ Device ID: %s\n", device_id);

	initialized = true;
	return 0;
}

const char* device_identity_get_imei(void)
{
	return initialized ? device_imei : "UNKNOWN";
}

const char* device_identity_get_id(void)
{
	return initialized ? device_id : "UNKNOWN";
}
```

## src/device_identity.h
```c
/*
 * Device Identity API
 */

#ifndef DEVICE_IDENTITY_H
#define DEVICE_IDENTITY_H

/* Initialize device identity (extracts IMEI) */
int device_identity_init(void);

/* Get device IMEI */
const char* device_identity_get_imei(void);

/* Get device ID (FLT-DEV-xxxxxxxx) */
const char* device_identity_get_id(void);

#endif /* DEVICE_IDENTITY_H */
```

## src/mqtt_manager.c
```c
/*
 * MQTT Manager - AWS IoT Core Connection
 * Custom Authorizer Implementation for nRF9160
 * Fixed for offloaded sockets mode
 */

#include "mqtt_manager.h"
#include "cert_provisioning.h"
#include <zephyr/kernel.h>
#include <zephyr/net/mqtt.h>
#include <zephyr/net/socket.h>
#include <zephyr/random/random.h>
#include <modem/modem_key_mgmt.h>
#include <zephyr/logging/log.h>
#include <string.h>

LOG_MODULE_REGISTER(mqtt_manager, LOG_LEVEL_INF);

/* AWS Configuration */
#define AWS_ENDPOINT "a3p4wum0t8th5r-ats.iot.us-east-2.amazonaws.com"
#define AWS_PORT 443  // Port 443 with ALPN for custom authorizer
#define AUTHORIZER_NAME "MainAuthorizer"

/* MQTT Buffers */
#define MQTT_BUFFER_SIZE 512
static uint8_t rx_buffer[MQTT_BUFFER_SIZE];
static uint8_t tx_buffer[MQTT_BUFFER_SIZE];
static uint8_t payload_buffer[512];

/* MQTT Client */
static struct mqtt_client client;
static struct sockaddr_storage broker;
static bool connected = false;
static char device_imei[32];

/* TLS Configuration - using security tags from cert_provisioning.h */
static sec_tag_t sec_tag_list[] = {
    AWS_SEC_TAG_ROOT_CA,
    AWS_SEC_TAG_DEVICE_CERT,
    AWS_SEC_TAG_DEVICE_KEY
};

/* MQTT Event Handler */
static void mqtt_evt_handler(struct mqtt_client *const c,
                             const struct mqtt_evt *evt)
{
    switch (evt->type) {
    case MQTT_EVT_CONNACK:
        if (evt->result == 0) {
            LOG_INF("✅ MQTT Connected to AWS IoT Core");
            connected = true;
        } else {
            LOG_ERR("❌ MQTT Connection failed: %d", evt->result);
            LOG_ERR("   Check: Certificates loaded? Lambda authorizer active?");
            connected = false;
        }
        break;

    case MQTT_EVT_DISCONNECT:
        LOG_WRN("📡 MQTT Disconnected: %d", evt->result);
        connected = false;
        break;

    case MQTT_EVT_PUBACK:
        LOG_DBG("✅ MQTT Publish ACK: msg_id=%d", evt->param.puback.message_id);
        break;

    case MQTT_EVT_PUBLISH:
        LOG_INF("📨 MQTT Echo received from AWS");
        LOG_INF("   Topic: %.*s",
                evt->param.publish.message.topic.topic.size,
                evt->param.publish.message.topic.topic.utf8);
        LOG_INF("   Payload: %d bytes", evt->param.publish.message.payload.len);
        LOG_HEXDUMP_INF(evt->param.publish.message.payload.data,
                        evt->param.publish.message.payload.len,
                        "Echo data:");
        break;

    default:
        LOG_DBG("MQTT Event: %d", evt->type);
        break;
    }
}

/* Poll MQTT socket - using offloaded socket API */
static void mqtt_poll_thread(void)
{
    struct zsock_pollfd fds;
    
    while (1) {
        if (connected) {
            fds.fd = client.transport.tcp.sock;
            fds.events = ZSOCK_POLLIN;
            
            int ret = zsock_poll(&fds, 1, 1000);
            
            if (ret > 0) {
                mqtt_input(&client);
            }
            
            mqtt_live(&client);
        } else {
            k_sleep(K_SECONDS(1));
        }
    }
}

K_THREAD_DEFINE(mqtt_poll_tid, 2048, mqtt_poll_thread, NULL, NULL, NULL, 7, 0, 0);

/* Initialize MQTT Manager */
int mqtt_manager_init(const char *imei)
{
    if (!imei) {
        return -EINVAL;
    }

    strncpy(device_imei, imei, sizeof(device_imei) - 1);
    LOG_INF("🔧 MQTT Manager init - IMEI: %s", device_imei);

    return 0;
}

/* Connect to AWS IoT Core */
int mqtt_manager_connect(void)
{
    int err;
    struct zsock_addrinfo *result;
    struct zsock_addrinfo hints = {
        .ai_family = AF_INET,
        .ai_socktype = SOCK_STREAM
    };

    if (connected) {
        LOG_INF("Already connected");
        return 0;
    }

    LOG_INF("☁️ Connecting to AWS IoT Core...");
    LOG_INF("   Endpoint: %s:%d", AWS_ENDPOINT, AWS_PORT);
    LOG_INF("   Authorizer: %s", AUTHORIZER_NAME);
    LOG_INF("   Client ID: %s", device_imei);

    /* Resolve endpoint - offloaded DNS */
    err = zsock_getaddrinfo(AWS_ENDPOINT, NULL, &hints, &result);
    if (err) {
        LOG_ERR("DNS lookup failed: %d", err);
        return err;
    }

    /* Setup broker address */
    struct sockaddr_in *broker_addr = (struct sockaddr_in *)&broker;
    broker_addr->sin_family = AF_INET;
    broker_addr->sin_port = htons(AWS_PORT);
    broker_addr->sin_addr.s_addr = ((struct sockaddr_in *)result->ai_addr)->sin_addr.s_addr;
    zsock_freeaddrinfo(result);

    /* Initialize MQTT client */
    mqtt_client_init(&client);

    /* Setup client ID (IMEI) */
    client.client_id.utf8 = (uint8_t *)device_imei;
    client.client_id.size = strlen(device_imei);

    /* Setup username for custom authorizer */
    static char username[128];
    snprintf(username, sizeof(username), "?x-amz-customauthorizer-name=%s", AUTHORIZER_NAME);
    static struct mqtt_utf8 user_name;
    user_name.utf8 = (uint8_t *)username;
    user_name.size = strlen(username);
    client.user_name = &user_name;

    /* Setup password (IMEI as token) */
    static struct mqtt_utf8 password;
    password.utf8 = (uint8_t *)device_imei;
    password.size = strlen(device_imei);
    client.password = &password;

    /* Setup broker */
    client.broker = &broker;
    client.evt_cb = mqtt_evt_handler;
    client.protocol_version = MQTT_VERSION_3_1_1;

    /* Setup TLS - modem handles encryption */
    client.transport.type = MQTT_TRANSPORT_SECURE;
    
    struct mqtt_sec_config *tls_config = &client.transport.tls.config;
    tls_config->peer_verify = TLS_PEER_VERIFY_REQUIRED;
    tls_config->cipher_count = 0;
    tls_config->sec_tag_count = ARRAY_SIZE(sec_tag_list);
    tls_config->sec_tag_list = sec_tag_list;
    tls_config->hostname = AWS_ENDPOINT;

    /* Setup buffers */
    client.rx_buf = rx_buffer;
    client.rx_buf_size = sizeof(rx_buffer);
    client.tx_buf = tx_buffer;
    client.tx_buf_size = sizeof(tx_buffer);

    /* Connect */
    LOG_INF("🔐 Starting TLS handshake...");
    err = mqtt_connect(&client);
    if (err) {
        LOG_ERR("❌ MQTT connect failed: %d", err);
        LOG_ERR("   Common causes:");
        LOG_ERR("   - Certificates not provisioned");
        LOG_ERR("   - Wrong security tags");
        LOG_ERR("   - Lambda authorizer rejecting IMEI");
        return err;
    }

    /* Wait for CONNACK */
    k_sleep(K_SECONDS(5));

    if (connected) {
        LOG_INF("✅ AWS IoT Core connected successfully");
    } else {
        LOG_WRN("⏰ Connection timeout - check RTT for errors");
    }

    return connected ? 0 : -ETIMEDOUT;
}

/* Publish data to AWS */
int mqtt_manager_publish(const char *topic, const uint8_t *data, size_t len)
{
    if (!connected) {
        LOG_WRN("Not connected - cannot publish");
        return -ENOTCONN;
    }

    if (len > sizeof(payload_buffer)) {
        LOG_ERR("Payload too large: %zu bytes", len);
        return -ENOMEM;
    }

    /* Copy to payload buffer */
    memcpy(payload_buffer, data, len);

    struct mqtt_publish_param param = {
        .message.topic.qos = MQTT_QOS_0_AT_MOST_ONCE,
        .message.topic.topic.utf8 = (uint8_t *)topic,
        .message.topic.topic.size = strlen(topic),
        .message.payload.data = payload_buffer,
        .message.payload.len = len,
        .message_id = sys_rand32_get() & 0xFFFF,
        .dup_flag = 0,
        .retain_flag = 0,
    };

    LOG_INF("📤 Publishing to: %s (%zu bytes)", topic, len);

    int err = mqtt_publish(&client, &param);
    if (err) {
        LOG_ERR("Publish failed: %d", err);
        return err;
    }

    LOG_INF("✅ Message sent");
    return 0;
}

/* Check connection status */
bool mqtt_manager_is_connected(void)
{
    return connected;
}

/* Disconnect */
void mqtt_manager_disconnect(void)
{
    if (connected) {
        mqtt_disconnect(&client, MQTT_DISCONNECT_NORMAL);
        connected = false;
        LOG_INF("Disconnected from AWS");
    }
}
```

## src/mqtt_manager.h
```c
/*
 * MQTT Manager - AWS IoT Core Connection
 * Handles MQTT connection with custom authorizer
 */

#ifndef MQTT_MANAGER_H
#define MQTT_MANAGER_H

#include <stdint.h>
#include <stddef.h>
#include <stdbool.h>

/* Initialize MQTT manager with device IMEI */
int mqtt_manager_init(const char *imei);

/* Connect to AWS IoT Core */
int mqtt_manager_connect(void);

/* Publish binary data to topic */
int mqtt_manager_publish(const char *topic, const uint8_t *data, size_t len);

/* Check if connected */
bool mqtt_manager_is_connected(void);

/* Disconnect from AWS */
void mqtt_manager_disconnect(void);

#endif /* MQTT_MANAGER_H */
```

## src/transmission_manager.c
```c
/*
 * Transmission Manager - LTE On-Demand Implementation for SDK 3.1.1
 * Handles intelligent data batching and transmission scheduling
 */

#include <zephyr/kernel.h>
#include <modem/lte_lc.h>
#include <modem/location.h>
#include <zephyr/logging/log.h>
#include "mqtt_manager.h"
#include "device_identity.h"
#include "aws_protocol.h"

LOG_MODULE_REGISTER(transmission_mgr, LOG_LEVEL_INF);

#define TRANSMISSION_BATCH_SIZE_MAX  20
#define TRANSMISSION_INTERVAL_SEC    300  /* 5 minutes */

/* Location data batch buffer */
struct location_batch {
    struct location_event_data locations[TRANSMISSION_BATCH_SIZE_MAX];
    uint8_t count;
    int64_t last_transmission_time;
};

static struct location_batch batch_buffer = {0};
static struct k_work transmission_work;
static struct k_work_delayable scheduled_transmission_work;

/* Add location to batch buffer */
int transmission_manager_add_location(const struct location_event_data *location)
{
    if (batch_buffer.count >= TRANSMISSION_BATCH_SIZE_MAX) {
        printk("📦 Batch buffer full (%d locations), triggering immediate transmission\n", 
               batch_buffer.count);
        k_work_submit(&transmission_work);
        return -ENOMEM;
    }
    
    memcpy(&batch_buffer.locations[batch_buffer.count], location, 
           sizeof(struct location_event_data));
    batch_buffer.count++;
    
    printk("📍 Location added to batch (%d/%d)\n", 
           batch_buffer.count, TRANSMISSION_BATCH_SIZE_MAX);
    
    return 0;
}

/* Transmit batch to cloud (placeholder for now) */
static void transmit_batch_to_cloud(void)
{
    if (batch_buffer.count == 0) {
        printk("📤 No data to transmit\n");
        return;
    }
    
    printk("\n========================================\n");
    printk("📤 TRANSMISSION: Sending batch of %d locations\n", batch_buffer.count);
    printk("========================================\n");
    
    /* Display the batch contents */
    for (int i = 0; i < batch_buffer.count; i++) {
        printk("  [%d] Lat: %.6f, Lon: %.6f, Acc: %.1fm\n",
               i + 1,
               batch_buffer.locations[i].location.latitude,
               batch_buffer.locations[i].location.longitude,
               batch_buffer.locations[i].location.accuracy);
    }
    
    printk("========================================\n\n");

    /* Get device IMEI for topic */
    const char *device_imei = device_identity_get_imei();
    if (!device_imei) {
        printk("❌ Failed to get IMEI\n");
        return;
    }

    /* Encode GPS batch to binary format */
    uint8_t binary_msg[512];
    size_t msg_len = 0;

    int err = aws_encode_gps_batch(batch_buffer.locations,
                                   batch_buffer.count,
                                   binary_msg,
                                   &msg_len);
    if (err) {
        printk("❌ GPS encoding failed: %d\n", err);
        return;
    }

    printk("📦 Encoded %d locations into %zu bytes\n",
           batch_buffer.count, msg_len);

    /* Ensure MQTT connected */
    if (!mqtt_manager_is_connected()) {
        printk("🔌 MQTT not connected - connecting now...\n");
        err = mqtt_manager_connect();
        if (err) {
            printk("❌ MQTT connection failed: %d - will retry next batch\n", err);
            return;  /* Don't clear batch - will retry */
        }
        /* Wait for connection to fully establish */
        k_sleep(K_SECONDS(3));
    }

    /* AWS echo test topic: aa/<IMEI>/test */
    char topic[128];
    snprintf(topic, sizeof(topic), "aa/%s/test", device_imei);

    /* Publish binary message */
    err = mqtt_manager_publish(topic, binary_msg, msg_len);
    if (err) {
        printk("❌ Publish failed: %d\n", err);
        return;
    }

    printk("✅ Published to %s (%zu bytes)\n", topic, msg_len);

    /* Clear batch after transmission */
    batch_buffer.count = 0;
    batch_buffer.last_transmission_time = k_uptime_get();
}

/* Transmission work handler */
static void transmission_work_handler(struct k_work *work)
{
    printk("🌐 Transmission triggered\n");
    
    /* TODO: In Phase 3B, we'll activate LTE here */
    /* For now, just transmit the batch */
    
    transmit_batch_to_cloud();
}

/* Scheduled transmission work handler */
static void scheduled_transmission_work_handler(struct k_work *work)
{
    printk("⏰ Scheduled transmission interval reached\n");
    k_work_submit(&transmission_work);
    
    /* Reschedule next transmission */
    k_work_schedule(&scheduled_transmission_work, K_SECONDS(TRANSMISSION_INTERVAL_SEC));
}

/* Initialize transmission manager */
int transmission_manager_init(void)
{
    printk("📡 Initializing transmission manager...\n");
    printk("   Batch size: %d locations\n", TRANSMISSION_BATCH_SIZE_MAX);
    printk("   Interval: %d seconds (%d minutes)\n", 
           TRANSMISSION_INTERVAL_SEC, TRANSMISSION_INTERVAL_SEC / 60);
    
    k_work_init(&transmission_work, transmission_work_handler);
    k_work_init_delayable(&scheduled_transmission_work, 
                          scheduled_transmission_work_handler);
    
    /* Schedule first transmission */
    k_work_schedule(&scheduled_transmission_work, K_SECONDS(TRANSMISSION_INTERVAL_SEC));

    printk("✅ Transmission manager initialized\n\n");

    /* Initialize MQTT manager */
    const char *device_imei = device_identity_get_imei();
    if (!device_imei) {
        printk("❌ Failed to get IMEI for MQTT init\n");
        return -EINVAL;
    }

    int err = mqtt_manager_init(device_imei);
    if (err) {
        printk("❌ MQTT manager init failed: %d\n", err);
        return err;
    }
    printk("✅ MQTT manager initialized (will connect on first transmission)\n");

    return 0;
}

/* Get transmission stats */
void transmission_manager_get_stats(uint8_t *batch_count, int64_t *last_tx_time)
{
    if (batch_count) {
        *batch_count = batch_buffer.count;
    }
    if (last_tx_time) {
        *last_tx_time = batch_buffer.last_transmission_time;
    }
}
```

## src/transmission_manager.h
```c
/*
 * Transmission Manager - Header File
 * Handles intelligent data batching and transmission scheduling
 */

#ifndef TRANSMISSION_MANAGER_H
#define TRANSMISSION_MANAGER_H

#include <modem/location.h>
#include <stdint.h>

/**
 * Initialize the transmission manager
 * 
 * @return 0 on success, negative error code on failure
 */
int transmission_manager_init(void);

/**
 * Add a location to the transmission batch buffer
 * 
 * @param location Pointer to location event data to add
 * @return 0 on success, -ENOMEM if buffer is full
 */
int transmission_manager_add_location(const struct location_event_data *location);

/**
 * Get current transmission statistics
 * 
 * @param batch_count Pointer to store current batch count (can be NULL)
 * @param last_tx_time Pointer to store last transmission time (can be NULL)
 */
void transmission_manager_get_stats(uint8_t *batch_count, int64_t *last_tx_time);

#endif /* TRANSMISSION_MANAGER_H */
```
